## bsp/allwinner/a733/e902/Kconfig
```kconfig
mainmenu "A733 E902 RT-Thread configuration"
config BSP_DIR
    string
    option env="BSP_DIR"
    default "."
config RTT_DIR
    string
    option env="RTT_DIR"
    default "../../../.."
source "$RTT_DIR/Kconfig"
source "$BSP_DIR/board/Kconfig"
```

## bsp/allwinner/a733/e902/board/Kconfig
```kconfig
config SOC_A733_E902
    bool
    default y
    select ARCH_RISCV_E902
    select RT_USING_NANO
    select RT_USING_COMPONENTS_INIT
    select RT_USING_USER_MAIN

menu "A733 E902 board options"
config BSP_USING_LINUX_TELEMETRY
    bool "Expose execution and fault telemetry in SRAM for the Linux host"
    default y
config BSP_USING_MSGBOX
    bool "CPUS hardware message box polling driver"
    default y
config BSP_USING_E902_DEMO
    bool "Multithread IPC/timer/mailbox example"
    depends on BSP_USING_LINUX_TELEMETRY && BSP_USING_MSGBOX && RT_USING_MESSAGEQUEUE && RT_USING_TIMER_SOFT
    default y
endmenu
```

## bsp/allwinner/a733/e902/defconfig
```kconfig
CONFIG_RT_KLIBC_USING_NO_VSSCANF=y
CONFIG_RT_NAME_MAX=16
CONFIG_RT_ALIGN_SIZE=4
CONFIG_IDLE_THREAD_STACK_SIZE=1024
CONFIG_RT_TIMER_THREAD_STACK_SIZE=1024
# CONFIG_RT_USING_MEMPOOL is not set
CONFIG_RT_USING_NOHEAP=y
# CONFIG_RT_USING_CONSOLE is not set
CONFIG_RT_BACKTRACE_LEVEL_MAX_NR=16
CONFIG_RT_MAIN_THREAD_PRIORITY=2
```
